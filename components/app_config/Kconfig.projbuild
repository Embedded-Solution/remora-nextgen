## components/app_config/Kconfig.projbuild
```kconfig
menu "App Settings"
config APP_DEBUG_DISABLE_VBUS_WAKE
    bool "Désactiver le réveil EXT1 (VBUS) pour le debug"
    default y
    
config APP_WIFI_SSID
    string "Wi-Fi SSID (STA)"
    default "YourSSID"

config APP_WIFI_PASS
    string "Wi-Fi password (STA)"
    default "YourPassword"

config APP_UPLOAD_URL
    string "Upload URL (HTTP POST)"
    default "http://example.com/api/dives/upload"

config APP_VBUS_SENSE_GPIO
    int "GPIO d'entrée pour l'alimentation externe (VBUS_SENSE)"
    range 0 48
    default 18

config APP_TOUCH_PAD_NUM
    int "Touch pad pour détection d'eau"
    range 0 14
    default 2

config APP_TOUCH_THRESH_PCT
    int "Seuil tactile (pourcent du baseline)"
    range 10 95
    default 70

config APP_MAX_RUN_SECONDS
    int "Durée max d'exécution (s) avant retour en deep-sleep"
    range 5 3600
    default 120

config RGB_LED_PIN_R
    int "GPIO pour Rouge"
    range 0 48
    default 15

config RGB_LED_PIN_G
    int "GPIO pour Vert"
    range 0 48
    default 16

config RGB_LED_PIN_B
    int "GPIO pour Bleu"
    range 0 48
    default 17

config RGB_LED_COMMON_ANODE
    bool "LED à anode commune (inversion du PWM)"
    default y

config RGB_LED_PWM_FREQ_HZ
    int "Fréquence PWM (Hz)"
    range 100 20000
    default 5000

config RGB_LED_PWM_RES_BITS
    int "Résolution PWM (bits)"
    range 8 13
    default 8

endmenu

menu "MS5837 pressure sensor"

config MS5837_I2C_ADDR
    hex "I2C address"
    default 0x76
    range 0x00 0x7F

config MS5837_SIMULATION
    bool "Enable simulation mode (no hardware needed)"
    default y

config MS5837_SIM_TEMP_MIN_C
    int "Simulated temperature min (°C)"
    default 15

config MS5837_SIM_TEMP_MAX_C
    int "Simulated temperature max (°C)"
    default 28

config MS5837_SIM_PRESS_MIN_BAR
    int "Simulated pressure min (bar *1000 => mbar)"
    default 1000

config MS5837_SIM_PRESS_MAX_BAR
    int "Simulated pressure max (bar *1000 => mbar)"
    default 1500

endmenu

menu "TSYS01 temperature sensor"

config TSYS01_I2C_ADDR
    hex "I2C address"
    default 0x77
    range 0x00 0x7F

config TSYS01_SIMULATION
    bool "Enable simulation mode (no hardware needed)"
    default y

config TSYS01_SIM_TEMP_MIN_C
    int "Simulated temperature min (°C)"
    default 10

config TSYS01_SIM_TEMP_MAX_C
    int "Simulated temperature max (°C)"
    default 30

endmenu
```

## sdkconfig.defaults
```kconfig
# Réseau / Wi-Fi
CONFIG_ESP_WIFI_SSID="dummy"
CONFIG_ESP_WIFI_PASSWORD="dummy"
CONFIG_ESP_WIFI_STA_AUTO_CONNECT=y

# HTTP client (mbedTLS)
CONFIG_ESP_HTTP_CLIENT_ENABLE_HTTPS=y

# LOG
CONFIG_LOG_DEFAULT_LEVEL_INFO=y # ou ESP_LOG_WARN / ESP_LOG_ERROR / ESP_LOG_DEBUG
CONFIG_ESP_MAIN_TASK_STACK_SIZE=8192

# Sleep / wake
CONFIG_FREERTOS_USE_TICKLESS_IDLE=y
CONFIG_ESP_SLEEP_GPIO_RESET_WORKAROUND=y
CONFIG_ESP_SLEEP_POWER_DOWN_FLASH=y
CONFIG_ESP_SLEEP_RTC_BUS_ISO_WORKAROUND=y
CONFIG_TOUCH_SENSOR_ENABLE=y
CONFIG_ESP_SLEEP_TOUCH_WAKEUP=y

# Touch driver legacy (API touch_pad_*)
CONFIG_TOUCH_PAD_FILTER_ENABLE=y

CONFIG_APP_TOUCH_PAD_NUM=2
CONFIG_APP_TOUCH_THRESH_PCT=70

# Leds 
CONFIG_RGB_LED_COMMON_ANODE=y
CONFIG_RGB_LED_PIN_R=15
CONFIG_RGB_LED_PIN_G=16
CONFIG_RGB_LED_PIN_B=17
CONFIG_RGB_LED_PWM_FREQ_HZ=5000
CONFIG_RGB_LED_PWM_RES_BITS=8
```
